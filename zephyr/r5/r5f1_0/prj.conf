## CMakeLists.txt
```
# SPDX-License-Identifier: MIT
#
# R5F1_0: a square wave on P8.18 from GPIO2.
# The part every core runs is in ../common/ (common.cmake).
cmake_minimum_required(VERSION 3.20.0)

# Every core's settings and devicetree bindings, then this core's own.
set(CONF_FILE ${CMAKE_CURRENT_LIST_DIR}/../common/common.conf ${CMAKE_CURRENT_LIST_DIR}/prj.conf)
list(APPEND DTS_ROOT ${CMAKE_CURRENT_LIST_DIR}/../common)

find_package(Zephyr REQUIRED HINTS $ENV{ZEPHYR_BASE})

project(ai64_r5f1_0 C CXX)

include(${CMAKE_CURRENT_LIST_DIR}/../common/common.cmake)

target_sources(app PRIVATE
  src/main.c
  src/blink.c
)
```

## Kconfig
```
# SPDX-License-Identifier: MIT

config AI64_BLINK_HALF_PERIOD_US
	int "Half period of the P8.18 square wave, in microseconds"
	default 500

source "Kconfig.zephyr"
```

## prj.conf
```kconfig
# The ELF is build/zephyr/r5f1_0/zephyr/ai64_r5f1_0.elf. That is not the
# kernel's default name (j7-main-r5f1_0-fw), so the core stays off at boot
# until ai64-demo starts it.
CONFIG_KERNEL_BIN_NAME="ai64_r5f1_0"

# A square wave on P8.18 from GPIO2 (src/blink.c). The device manager powers
# GPIO2, over TI-SCI; the power domain turns it on at boot, before the GPIO
# driver starts.
CONFIG_GPIO=y
CONFIG_POWER_DOMAIN=y
CONFIG_POWER_DOMAIN_TISCI_INIT_PRIORITY=20

# This core has no console UART. Its log goes to a RAM buffer that the
# resource table lists as a trace, so Linux reads it at
# /sys/kernel/debug/remoteproc/remoteprocN/trace0.
CONFIG_CONSOLE=y
CONFIG_RAM_CONSOLE=y
CONFIG_LOG_MODE_MINIMAL=y
```

## app.overlay
```dts
// SPDX-License-Identifier: MIT
#include <zephyr/dt-bindings/interrupt-controller/ti-vim.h>

/*
 * TI-SCI, the device manager's API. Zephyr's TI-SCI driver talks to it over
 * this host's (40) threads on main_sec_proxy0: 83 (low_priority,
 * write) and 81 (response, read; k3conf show threads). The polled mailbox
 * driver in common/src/sproxy.c carries it, since no secure proxy interrupt
 * reaches an R5F here. reg is the device manager's debug window, which the
 * binding asks for and nothing reads.
 */
/ {
	ai64_sproxy: mailbox@32c00000 {
		compatible = "ai64,secure-proxy-poll";
		reg = <0x32c00000 0x100000>, <0x32400000 0x100000>;
		reg-names = "target_data", "rt";
		#mbox-cells = <1>;
	};

	dmsc: system-controller@44083000 {
		compatible = "ti,k2g-sci";
		reg = <0x44083000 0x1000>;
		ti,host-id = <40>;
		mboxes = <&ai64_sproxy 81>, <&ai64_sproxy 83>;
		mbox-names = "rx", "tx";
	};
};

/*
 * The mailbox interrupt route this core asks the device manager for at boot
 * (common/src/tisci.c), through Zephyr's TI-SCI driver.
 * NAVSS0_MAILBOX_2 user 1 arrives on NAVSS0_INTR_ROUTER_0
 * (device 213) input 429. Output 260 is the first of this host's range
 * (k3conf dump rm 213) and lands on this core's VIM input 228.
 */
/ {
	ai64_tisci: tisci-route {
		compatible = "ai64,tisci-irq-route";
		ir-id = <213>;
		ir-input = <429>;
		ir-output = <260>;
	};
};

/* The board puts the mailbox on VIM 256, which nothing routes to. */
&mbox2 {
	interrupts = <0 228 IRQ_TYPE_LEVEL IRQ_DEFAULT_PRIORITY>;
};

/*
 * The links to the other three R5F cores (common/ai64_ipc.dtsi). This core's
 * doorbells are NAVSS0_MAILBOX_10 user 2, which arrives on router input
 * 398 (TI-SCI's pend_intr 1); output 261, the next of this host's range,
 * lands on VIM input 229.
 */
#define AI64_IPC_SELF 2
#include "../common/ai64_ipc.dtsi"

/ {
	ai64_tisci_ipc: tisci-route-ipc {
		compatible = "ai64,tisci-irq-route";
		ir-id = <213>;
		ir-input = <398>;
		ir-output = <261>;
	};

	AI64_IPC_LINK(2, 0)
	AI64_IPC_LINK(2, 1)
	AI64_IPC_LINK(2, 3)
};

/*
 * R5F1_0's job: a square wave on P8.18 (src/blink.c).
 *
 * The pad, AJ23 at 0x010, is GPIO0_4 in mux mode 7. Bits 5:4 of a J721E
 * pad register pick which of the main domain's GPIO0, GPIO2, GPIO4, and
 * GPIO6 drives it (1 is GPIO2). Linux owns GPIO0, and has outputs in every
 * one of its banks, but leaves GPIO2 disabled, so this core takes GPIO2
 * whole: Zephyr's GPIO driver sets every pin of a bank to input when it
 * starts. GPIO2's power and clock come from the device manager (device
 * 107), which the power domain turns on at boot.
 */
#include <zephyr/dt-bindings/pinctrl/ti-k3-pinctrl.h>
#include <zephyr/dt-bindings/gpio/gpio.h>

#define AI64_GPIO2_SEL (1 << 4)

&pinctrl {
	ai64_blink_p8_18: ai64-blink-p8-18 {
		/* P8.18 AJ23 GPIO0_4, here GPIO2_4, mode 7 */
		pinmux = <K3_PINMUX(0x0010, PIN_OUTPUT | AI64_GPIO2_SEL, MUX_MODE_7)>;
	};
};

/ {
	power-domains {
		gpio2_pd: gpio2-pd {
			compatible = "ti,sci-pm-domain";
			tisci,device-id = <107>;
			tisci,device-mode = "EXCLUSIVE";
			#power-domain-cells = <0>;
		};
	};

	zephyr,user {
		blink-gpios = <&main_gpio2 4 GPIO_ACTIVE_HIGH>;
	};
};

/* GPIO2's first bank, pins 0 to 31 (main_gpio2 maps pin n to it). */
&main_gpio2_0 {
	power-domains = <&gpio2_pd>;
	pinctrl-0 = <&ai64_blink_p8_18>;
	pinctrl-names = "default";
	status = "okay";
};
```

## src/main.c
```c
/* SPDX-License-Identifier: MIT */
/*
 * R5F1_0: a square wave on P8.18 from GPIO2, toggled by a kernel timer,
 * which times itself on the GTC (blink.c).
 *
 * Like every R5F core it also runs ../common/: RPMsg and eRPC to Linux,
 * ipc_service links to the other three, and its fabric node. ai64_r5_core
 * below is what this core adds to that, and start() starts its own job.
 */

#include <zephyr/kernel.h>
#include <zephyr/init.h>
#include <zephyr/logging/log.h>

#include "ai64_r5.h"
#include "r5f1_0.h"

LOG_MODULE_DECLARE(ai64_r5, LOG_LEVEL_INF);

const struct ai64_r5_core ai64_r5_core = {
	.status = blink_status,
};

/* At the APPLICATION init level: after the drivers, before main() and the
 * common threads. */
static int start(void)
{
	blink_start();
	return 0;
}

SYS_INIT(start, APPLICATION, CONFIG_APPLICATION_INIT_PRIORITY);

int main(void)
{
	LOG_INF("ai64 " AI64_CORE " hello");
	return 0;
}
```

## src/blink.c
```c
/* SPDX-License-Identifier: MIT */
/*
 * R5F1_0's job: a square wave on P8.18, Zephyr's blinky with a logic
 * analyzer in mind.
 *
 * A periodic k_timer toggles GPIO2_4 (the overlay muxes it to P8.18) every
 * CONFIG_AI64_BLINK_HALF_PERIOD_US, from the timer's interrupt, through
 * Zephyr's GPIO driver: 1 kHz with the default 500 us. Each toggle reads the
 * GTC, so the core measures its own timing: how far each half period is
 * from the one asked for. Every 1000 toggles it keeps the smallest, the
 * largest, and the mean of those, for the status line.
 */

#include <zephyr/kernel.h>
#include <zephyr/drivers/gpio.h>
#include <zephyr/sys/sys_io.h>
#include <zephyr/logging/log.h>
#include <stdio.h>

#include "ai64_shm.h"
#include "r5f1_0.h"

LOG_MODULE_DECLARE(ai64_r5, LOG_LEVEL_INF);

#define HALF_US      CONFIG_AI64_BLINK_HALF_PERIOD_US
#define HALF_GTC     ((int32_t)(HALF_US * (AI64_GTC_HZ / 1000000u)))
#define WINDOW       1000u
#define GTC_NS(t)    ((int32_t)(t) * (int32_t)(1000000000u / AI64_GTC_HZ))

static const struct gpio_dt_spec pin = GPIO_DT_SPEC_GET(DT_PATH(zephyr_user), blink_gpios);

struct window {
	int32_t min, max;
	int64_t sum;
	uint32_t n;
};

static struct window cur, last;
static uint32_t toggles, prev;
static int32_t worst;
static struct k_spinlock lock;

static void blink(struct k_timer *t)
{
	uint32_t now = sys_read32(AI64_GTC_ADDR + 8u);
	int32_t err;
	k_spinlock_key_t key;

	ARG_UNUSED(t);
	(void)gpio_pin_toggle_dt(&pin);
	key = k_spin_lock(&lock);
	if (toggles++ != 0u) {
		err = (int32_t)(now - prev) - HALF_GTC;
		if (cur.n == 0u || err < cur.min) {
			cur.min = err;
		}
		if (cur.n == 0u || err > cur.max) {
			cur.max = err;
		}
		if ((err < 0 ? -err : err) > worst) {
			worst = err < 0 ? -err : err;
		}
		cur.sum += err;
		if (++cur.n == WINDOW) {
			last = cur;
			cur = (struct window){0};
		}
	}
	prev = now;
	k_spin_unlock(&lock, key);
}

static K_TIMER_DEFINE(timer, blink, NULL);

void blink_status(char *buf, size_t len)
{
	struct window w;
	uint32_t n;
	int32_t wst;
	k_spinlock_key_t key = k_spin_lock(&lock);

	w = last;
	n = toggles;
	wst = worst;
	k_spin_unlock(&lock, key);
	if (w.n == 0u) {
		snprintf(buf, len, "P8.18: %u toggles, every %u us", n, HALF_US);
		return;
	}
	snprintf(buf, len,
		 "P8.18: %u toggles, every %u us; last %u off by %d to %d ns, mean %d; worst %d ns",
		 n, HALF_US, w.n, GTC_NS(w.min), GTC_NS(w.max), GTC_NS((int32_t)(w.sum / w.n)),
		 GTC_NS(wst));
}

void blink_start(void)
{
	int ret;

	if (!gpio_is_ready_dt(&pin)) {
		LOG_ERR("blink: GPIO2 is not ready");
		return;
	}
	ret = gpio_pin_configure_dt(&pin, GPIO_OUTPUT_INACTIVE);
	if (ret) {
		LOG_ERR("blink: P8.18 configure failed (%d)", ret);
		return;
	}
	k_timer_start(&timer, K_USEC(HALF_US), K_USEC(HALF_US));
	LOG_INF("blink: P8.18 toggles every %u us", HALF_US);
}
```

## src/r5f1_0.h
```c
/* SPDX-License-Identifier: MIT */
#ifndef R5F1_0_H_
#define R5F1_0_H_

#include <stddef.h>

/* The square wave on P8.18, blink.c. */
void blink_status(char *buf, size_t len);
/* Starts the timer. */
void blink_start(void);

#endif
```
