## CMakeLists.txt
```
# SPDX-License-Identifier: MIT
#
# R5F0_0: SPI7 on header P9, the bulk buffer Linux writes, a UDMA channel, and
# the pipeline's move into the C66x cores. It also sends the fabric's tours.
# The part every core runs is in ../common/ (common.cmake).
# sysbuild.cmake adds the other three cores' apps to this build.

cmake_minimum_required(VERSION 3.20.0)

# Every core's settings and devicetree bindings, then this core's own.
set(CONF_FILE ${CMAKE_CURRENT_LIST_DIR}/../common/common.conf ${CMAKE_CURRENT_LIST_DIR}/prj.conf)
list(APPEND DTS_ROOT ${CMAKE_CURRENT_LIST_DIR}/../common)

find_package(Zephyr REQUIRED HINTS $ENV{ZEPHYR_BASE})

project(ai64_r5f0_0 C CXX)

include(${CMAKE_CURRENT_LIST_DIR}/../common/common.cmake)

# The fabric's tours start here (zephyr/include/ai64_fabric.h).
target_compile_definitions(app PRIVATE AI64_FAB_TOURS=1)

target_sources(app PRIVATE
  src/main.c
  src/spi.c
  src/bulk.c
  src/dma.c
  src/pipe_dma.c
)
```

## prj.conf
```kconfig
# The ELF is build/zephyr/r5f0_0/zephyr/ai64_r5f0_0.elf. That is not the
# kernel's default name (j7-main-r5f0_0-fw), so the core stays off at boot
# until ai64-demo starts it.
CONFIG_KERNEL_BIN_NAME="ai64_r5f0_0"

# SPI7 on header P9 (src/spi.c). The core keeps the board's UART2 console.
CONFIG_SPI=y
```

## app.overlay
```dts
// SPDX-License-Identifier: MIT
#include <zephyr/dt-bindings/pinctrl/ti-k3-pinctrl.h>
#include <freq.h>
#include <zephyr/dt-bindings/interrupt-controller/ti-vim.h>

/*
 * Carve the bulk chunk region out of R5F0_0 DDR: 64 KiB at 0xa2fef000,
 * matching AI64_BULK_ADDR. ddr1 starts at 0xa2200000; the board's ddr1
 * (14 MiB) ended at 0xa3000000, and the last 4 KiB stay unused.
 */

&ddr1 {
	reg = <0xa2200000 0xdef000>;
};

/*
 * 0x200000 is the pad's TX-disable bit (PIN_DISABLE in the Linux header),
 * OR mux mode 7, so a shorted partner ball stays off. The K3 pinctrl helper
 * applies only the first two pinmux cells of each group, so each group has
 * one pin.
 */
#define AI64_PIN_OFF 0x200000

/ {
	ai64_bulk: memory@a2fef000 {
		compatible = "zephyr,memory-region", "mmio-sram";
		reg = <0xa2fef000 0x10000>;
		zephyr,memory-region = "AI64_BULK";
	};

	/*
	 * Main SPI7. Linux leaves it disabled, and the board firmware keeps
	 * its power domain on. The driver polls, so there is no interrupt.
	 * Its functional clock is 50 MHz: with 48 here, the driver's divider
	 * of 48 for 1 MHz gave a 0.96 us clock on a logic analyzer.
	 */
	main_spi7: spi@2170000 {
		compatible = "ti,omap-mcspi";
		reg = <0x02170000 0x400>;
		clock-frequency = <DT_FREQ_M(50)>;
		ti,spi-num-cs = <1>;
		ti,d1-miso-d0-mosi;
		#address-cells = <1>;
		#size-cells = <0>;
		pinctrl-names = "default";
		pinctrl-0 = <&ai64_spi7_clk &ai64_spi7_cs0 &ai64_spi7_d0
			     &ai64_spi7_off_p9_31b &ai64_spi7_off_p9_28b
			     &ai64_spi7_off_p9_30b>;
		status = "okay";
	};
};

&pinctrl {
	ai64_spi7_clk: ai64-spi7-clk {
		/* P9.31a U3 EXT_REFCLK1.SPI7_CLK, mode 6 */
		pinmux = <K3_PINMUX(0x0234, PIN_OUTPUT, MUX_MODE_6)>;
	};
	ai64_spi7_cs0: ai64-spi7-cs0 {
		/* P9.28a U2 ECAP0_IN_APWM_OUT.SPI7_CS0, mode 6 */
		pinmux = <K3_PINMUX(0x0230, PIN_OUTPUT, MUX_MODE_6)>;
	};
	ai64_spi7_d0: ai64-spi7-d0 {
		/* P9.30a V6 TIMER_IO0.SPI7_D0, MOSI, mode 6 */
		pinmux = <K3_PINMUX(0x0238, PIN_OUTPUT, MUX_MODE_6)>;
	};
	ai64_spi7_off_p9_31b: ai64-spi7-off-p9-31b {
		/* P9.31b AB26, shorted to P9.31a */
		pinmux = <K3_PINMUX(0x00d4, AI64_PIN_OFF, MUX_MODE_7)>;
	};
	ai64_spi7_off_p9_28b: ai64-spi7-off-p9-28b {
		/* P9.28b AF28, shorted to P9.28a */
		pinmux = <K3_PINMUX(0x00b0, AI64_PIN_OFF, MUX_MODE_7)>;
	};
	ai64_spi7_off_p9_30b: ai64-spi7-off-p9-30b {
		/* P9.30b AE28, shorted to P9.30a */
		pinmux = <K3_PINMUX(0x00b4, AI64_PIN_OFF, MUX_MODE_7)>;
	};
};

/*
 * TI-SCI, the device manager's API. Zephyr's TI-SCI driver talks to it over
 * this host's (35) threads on main_sec_proxy0: 63 (low_priority,
 * write) and 61 (response, read; k3conf show threads). The polled mailbox
 * driver in common/src/sproxy.c carries it, since no secure proxy interrupt
 * reaches an R5F here. reg is the device manager's debug window, which the
 * binding asks for and nothing reads.
 */
/ {
	ai64_sproxy: mailbox@32c00000 {
		compatible = "ai64,secure-proxy-poll";
		reg = <0x32c00000 0x100000>, <0x32400000 0x100000>;
		reg-names = "target_data", "rt";
		#mbox-cells = <1>;
	};

	dmsc: system-controller@44083000 {
		compatible = "ti,k2g-sci";
		reg = <0x44083000 0x1000>;
		ti,host-id = <35>;
		mboxes = <&ai64_sproxy 61>, <&ai64_sproxy 63>;
		mbox-names = "rx", "tx";
	};
};

/*
 * The mailbox interrupt route this core asks the device manager for at boot
 * (common/src/tisci.c), through Zephyr's TI-SCI driver.
 * NAVSS0_MAILBOX_1 user 2 arrives on NAVSS0_INTR_ROUTER_0
 * (device 213) input 434. Output 196 is the first of this host's range
 * (k3conf dump rm 213) and lands on this core's VIM input 228.
 */
/ {
	ai64_tisci: tisci-route {
		compatible = "ai64,tisci-irq-route";
		ir-id = <213>;
		ir-input = <434>;
		ir-output = <196>;
	};
};

/* The board puts the mailbox on VIM 256, which nothing routes to. */
&mbox1 {
	interrupts = <0 228 IRQ_TYPE_LEVEL IRQ_DEFAULT_PRIORITY>;
};

/*
 * The links to the other three R5F cores (common/ai64_ipc.dtsi). This core's
 * doorbells are NAVSS0_MAILBOX_11 user 1, which arrives on router input 393
 * (TI-SCI's pend_intr 0); output 197, the next of this host's range, lands
 * on VIM input 229.
 */
#define AI64_IPC_SELF 0
#include "../common/ai64_ipc.dtsi"

/ {
	ai64_tisci_ipc: tisci-route-ipc {
		compatible = "ai64,tisci-irq-route";
		ir-id = <213>;
		ir-input = <393>;
		ir-output = <197>;
	};

	AI64_IPC_LINK(0, 1)
	AI64_IPC_LINK(0, 2)
	AI64_IPC_LINK(0, 3)
};
```

## src/main.c
```c
/* SPDX-License-Identifier: MIT */
/*
 * R5F0_0: SPI7 on header P9 (spi.c), the bulk buffer Linux writes (bulk.c),
 * a UDMA channel (dma.c), and the pipeline's move (pipe_dma.c): each window
 * of P8.31 samples from ICSSG0 into a C66x's L2 SRAM. It keeps the board's
 * UART2 console, and sends the fabric's tours.
 *
 * Like every R5F core it also runs ../common/: RPMsg and eRPC to Linux,
 * ipc_service links to the other three, and its fabric node. ai64_r5_core
 * below is what this core adds to that, and start() starts its own job.
 */

#include <zephyr/kernel.h>
#include <zephyr/init.h>
#include <zephyr/logging/log.h>

#include "ai64_r5.h"
#include "dma.h"
#include "r5f0_0.h"

LOG_MODULE_DECLARE(ai64_r5, LOG_LEVEL_INF);

const struct ai64_r5_core ai64_r5_core = {
	.status = spi7_status,
	.request = spi7_request,
	.chunk = bulk_chunk,
	.dma = bulk_dma,
	/* A channel left on would still be on when the core runs again. */
	.shutdown = dma_stop,
};

/* At the APPLICATION init level: after the drivers, before main() and the
 * common threads. */
static int start(void)
{
	spi7_start();
	pipe_dma_start();
	return 0;
}

SYS_INIT(start, APPLICATION, CONFIG_APPLICATION_INIT_PRIORITY);

int main(void)
{
	LOG_INF("ai64 " AI64_CORE " hello");
	return 0;
}
```

## src/bulk.c
```c
/* SPDX-License-Identifier: MIT */
/*
 * R5F0_0's bulk buffer, 64 KiB of DDR Linux writes through /dev/mem
 * (struct ai64_bulk, ai64_shm.h), and Linux's two calls on it: takeChunk
 * checks what Linux wrote there, and dmaCopy copies from it into the C7x's
 * job block with this core's UDMA channel (dma.c), and nowhere else. The
 * overlay keeps the Zephyr image out of the buffer, and the MPU maps it
 * non-cacheable (common/src/mpu.c).
 */

#include <zephyr/kernel.h>
#include <zephyr/cache.h>
#include <zephyr/sys/sys_io.h>
#include <zephyr/logging/log.h>

#include <errno.h>
#include <stdint.h>
#include <string.h>

#include "ai64_shm.h"
#include "ai64_dsp_job.h"
#include "dma.h"
#include "r5f0_0.h"

LOG_MODULE_DECLARE(ai64_r5, LOG_LEVEL_INF);

BUILD_ASSERT(DT_NODE_EXISTS(DT_NODELABEL(ai64_bulk)), "R5F0_0's overlay has the bulk buffer");

static volatile struct ai64_bulk *const bulk =
	(volatile struct ai64_bulk *)AI64_BULK_ADDR;

uint32_t bulk_chunk(uint32_t seq, uint32_t length, uint32_t crc)
{
	uint32_t got;
	uint32_t magic;
	uint32_t got_seq;
	uint32_t got_len;
	uint32_t got_crc;

	if (length > sizeof(bulk->data)) {
		return 0;
	}
	sys_cache_data_invd_range((void *)bulk, 16u + length);
	magic = bulk->magic;
	got_seq = bulk->seq;
	got_len = bulk->length;
	got_crc = bulk->crc;
	if (magic != AI64_BULK_MAGIC || got_seq != seq || got_len != length ||
	    got_crc != crc) {
		LOG_INF("chunk mismatch magic %08x seq %u len %u crc %08x",
			magic, got_seq, got_len, got_crc);
		return 0;
	}
	got = ai64_crc32((const uint8_t *)bulk->data, length);
	LOG_INF("chunk seq %u len %u crc %08x", seq, length, got);
	return got;
}

/* Whether [a, a + n) lies inside [base, base + size). */
static bool inside(uint32_t a, uint32_t n, uint64_t base, uint32_t size)
{
	return a >= base && n <= size && a - base <= size - n;
}

/* Where the R5F's own copy goes, for cpu_ns. */
static uint8_t cpu_copy[0x4000] __aligned(64);

int32_t bulk_dma(uint32_t dst, uint32_t src, uint32_t length, uint32_t *cpu_ns)
{
	uint32_t ns = 0, t0, n;
	int ret;

	*cpu_ns = 0;
	if (!inside(src, length, AI64_BULK_ADDR + 16u, AI64_BULK_SIZE - 16u) ||
	    !inside(dst, length, AI64_JOB_C7X_PHYS, AI64_JOB_SIZE)) {
		LOG_INF("erpc dma: %#x -> %#x, %u bytes: only bulk buffer -> C7x job block", src, dst,
			length);
		return -EINVAL;
	}
	ret = dma_copy(dst, src, length, &ns);
	if (ret) {
		LOG_ERR("erpc dma: failed (%d)", ret);
		return ret;
	}
	/* The same bytes copied by this core, as far as cpu_copy holds them. */
	n = length < sizeof(cpu_copy) ? length : sizeof(cpu_copy);
	t0 = sys_read32(AI64_GTC_ADDR + 8u);
	memcpy(cpu_copy, (const void *)(uintptr_t)src, n);
	*cpu_ns = (uint32_t)((uint64_t)(sys_read32(AI64_GTC_ADDR + 8u) - t0) *
			     (1000000000u / AI64_GTC_HZ) * length / n);
	LOG_INF("erpc dma: %u bytes in %u ns (memcpy %u ns)", length, ns, *cpu_ns);
	return (int32_t)ns;
}
```

## src/dma.c
```c
/* SPDX-License-Identifier: MIT */
/*
 * R5F0_0's DMA: one memory-to-memory channel of the main NAVSS UDMA.
 *
 * Zephyr has no UDMA driver for J721E, so this file does what Linux's and
 * U-Boot's k3-udma drivers do for a memcpy channel, polled:
 *
 * - From the device manager, over TI-SCI (Zephyr's driver): this host's
 *   ranges of UDMAP transmit and receive channels and of general-purpose
 *   rings; then ring configs for the channel's transmit ring (ring n for
 *   channel n) and a completion ring, the channel pair's configs as block
 *   copy channels (TI-SCI channel type 12), and the PSI-L pairing that
 *   joins the transmit thread to the receive thread.
 * - Then, with no more TI-SCI: each copy is one CPPI5 TR descriptor with
 *   one type-15 TR (source and destination, up to 64 KiB here). The core
 *   writes its address into the transmit ring and rings the ring's
 *   doorbell; the UDMA reads the descriptor, moves the bytes, and returns
 *   the descriptor to the completion ring, which the core polls.
 * - dma_copy_bell() puts a second TR after the copy, which writes a
 *   word: a doorbell for whoever waits on the copy. Every TR has the WAIT
 *   flag, so the second only starts once the first one's writes have
 *   landed, and the word is never seen before the bytes it stands for.
 *
 * The rings and the descriptor live in the non-cacheable 4 KiB that
 * common/ai64_ipc.dtsi leaves unused (the slot for core 0 to itself), so
 * neither side needs cache work on them.
 */

#include <zephyr/kernel.h>
#include <zephyr/device.h>
#include <zephyr/drivers/firmware/tisci/tisci.h>
#include <zephyr/sys/sys_io.h>
#include <zephyr/sys/barrier.h>
#include <zephyr/logging/log.h>
#include <errno.h>
#include <string.h>

#include "dma.h"
#include "ai64_shm.h"

LOG_MODULE_REGISTER(ai64_dma, LOG_LEVEL_INF);

/* TI-SCI device IDs (k3-j721e-main.dtsi). */
#define NAVSS_ID   199u /* main NAVSS: PSI-L pairing */
#define RINGACC_ID 211u
#define UDMAP_ID   212u

/* Resource subtypes. */
#define RA_GP_RINGS     0x01u
#define UDMAP_RX_CHAN   0x0au
#define UDMAP_TX_CHAN   0x0du

/* Realtime registers: one 4 KiB page per ring and per channel. */
#define RING_RT(n)      (0x3c000000u + (n) * 0x1000u)
#define RING_RT_DB      0x10u
#define RING_RT_OCC     0x18u
#define TCHAN_RT(n)     (0x35000000u + (n) * 0x1000u)
#define RCHAN_RT(n)     (0x34000000u + (n) * 0x1000u)
#define CHAN_RT_CTL     0x0u
#define CHAN_RT_CTL_EN  BIT(31)

/* TI-SCI values the Zephyr header leaves out (TI's ti_sci_protocol.h). */
#define RING_ALL_NO_ORDER    0x1fu
#define RING_MODE_RING       0u
#define RING_ELSIZE_8        1u
#define CH_CHAN_TYPE_VALID   BIT(2)
#define CH_FETCH_SIZE_VALID  BIT(3)
#define CH_CQ_QNUM_VALID     BIT(4)
#define CHAN_TYPE_BCOPY_PBRR 12u

/* PSI-L thread IDs of main UDMAP channel n. */
#define PSIL_SRC(n) (0x1000u + (n))
#define PSIL_DST(n) (0x9000u + (n))

#define RING_ELEMS 16u

/* CPPI5 TR descriptor: a 64-byte header record, one 64-byte TR, and its response. */
struct tr15 {
	uint32_t flags;
	uint16_t icnt0, icnt1;
	uint64_t addr;
	int32_t dim1;
	uint16_t icnt2, icnt3;
	int32_t dim2, dim3;
	uint32_t reserved;
	int32_t ddim1;
	uint64_t daddr;
	int32_t ddim2, ddim3;
	uint16_t dicnt0, dicnt1, dicnt2, dicnt3;
} __packed __aligned(64);

#define MAX_TRS 2u

struct trdesc {
	uint32_t info0, info1, info2, tag;
	uint8_t pad[48];
	struct tr15 tr[MAX_TRS];
	uint32_t response[MAX_TRS];
} __aligned(64);

BUILD_ASSERT(sizeof(struct tr15) == 64, "a type-15 TR is 64 bytes");

#define INFO0_TYPE_TR       (3u << 30)
#define INFO1_RECSIZE_64B   (2u << 24)
#define INFO1_PKTID(id)     ((uint32_t)(id) << 14)
#define INFO1_FLOWID_NONE   0x3fffu
#define TR_TYPE15           15u
#define TR_WAIT             BIT(5)
#define TR_CSF_SUPR_EVT     (BIT(2) << 24)
#define TR_CSF_EOP          (BIT(7) << 24)

/* The non-cacheable slot: descriptor, the two rings, and a doorbell's word. */
struct dma_mem {
	struct trdesc desc;
	uint64_t tx_ring[RING_ELEMS];
	uint64_t cq_ring[RING_ELEMS];
	uint32_t bell;
};

#define DMA_MEM_NODE DT_NODELABEL(ai64_dma_mem)
BUILD_ASSERT(DT_REG_SIZE(DMA_MEM_NODE) >= sizeof(struct dma_mem), "the DMA slot holds it");
static volatile struct dma_mem *const mem = (volatile struct dma_mem *)DT_REG_ADDR(DMA_MEM_NODE);

static const struct device *const dmsc = DEVICE_DT_GET(DT_NODELABEL(dmsc));
static K_MUTEX_DEFINE(lock);
static uint16_t chan, cq_ring;
static uint32_t tx_widx, cq_ridx;
static bool ready;

static int setup(void)
{
	struct tisci_msg_rm_udmap_tx_ch_cfg tx = {0};
	struct tisci_msg_rm_udmap_rx_ch_cfg rx = {0};
	uint16_t t0 = 0, tn = 0, r0 = 0, rn = 0, g0 = 0, gn = 0;
	int ret;

	ret = tisci_cmd_get_resource_range(dmsc, UDMAP_ID, UDMAP_TX_CHAN, &t0, &tn);
	ret = ret ? ret : tisci_cmd_get_resource_range(dmsc, UDMAP_ID, UDMAP_RX_CHAN, &r0, &rn);
	ret = ret ? ret : tisci_cmd_get_resource_range(dmsc, RINGACC_ID, RA_GP_RINGS, &g0, &gn);
	if (ret) {
		LOG_ERR("dma: no UDMA resources for this host (%d)", ret);
		return ret;
	}
	/* A pair needs the same number from both ranges. */
	if (r0 > t0 || r0 + rn <= t0 || tn == 0 || gn == 0) {
		LOG_ERR("dma: tx %u+%u and rx %u+%u share no channel", t0, tn, r0, rn);
		return -ENODEV;
	}
	chan = t0;
	cq_ring = g0;

	/*
	 * A pairing the last run left: undone (a NACK just means there was
	 * none). Its channel is off already (dma_stop() at shutdown).
	 * The channel's realtime registers are not touched before TI-SCI has
	 * configured it for this host: an R5F write there before that is
	 * refused, and the abort it leaves pending keeps the core out of WFI,
	 * so the kernel cannot stop it ("can't stop rproc: -110").
	 */
	(void)tisci_cmd_rm_psil_unpair(dmsc, NAVSS_ID, PSIL_SRC(chan), PSIL_DST(chan));

	memset((void *)mem, 0, sizeof(*mem));
	ret = tisci_cmd_ring_config(dmsc, RING_ALL_NO_ORDER, RINGACC_ID, chan,
				    (uint32_t)(uintptr_t)mem->tx_ring, 0, RING_ELEMS, RING_MODE_RING,
				    RING_ELSIZE_8, 0);
	ret = ret ? ret : tisci_cmd_ring_config(dmsc, RING_ALL_NO_ORDER, RINGACC_ID, cq_ring,
						(uint32_t)(uintptr_t)mem->cq_ring, 0, RING_ELEMS,
						RING_MODE_RING, RING_ELSIZE_8, 0);
	if (ret) {
		LOG_ERR("dma: ring config failed (%d)", ret);
		return ret;
	}

	tx.valid_params = CH_CHAN_TYPE_VALID | CH_FETCH_SIZE_VALID | CH_CQ_QNUM_VALID;
	tx.nav_id = UDMAP_ID;
	tx.index = chan;
	tx.tx_chan_type = CHAN_TYPE_BCOPY_PBRR;
	tx.tx_fetch_size = 16u >> 2; /* the descriptor's first 16 bytes, in words */
	tx.txcq_qnum = cq_ring;
	ret = tisci_cmd_rm_udmap_tx_ch_cfg(dmsc, &tx);
	if (ret) {
		LOG_ERR("dma: tx channel %u config failed (%d)", chan, ret);
		return ret;
	}
	rx.valid_params = CH_CHAN_TYPE_VALID | CH_FETCH_SIZE_VALID | CH_CQ_QNUM_VALID;
	rx.nav_id = UDMAP_ID;
	rx.index = chan;
	rx.rx_chan_type = CHAN_TYPE_BCOPY_PBRR;
	rx.rx_fetch_size = 16u >> 2;
	rx.rxcq_qnum = cq_ring;
	ret = tisci_cmd_rm_udmap_rx_ch_cfg(dmsc, &rx);
	if (ret) {
		LOG_ERR("dma: rx channel %u config failed (%d)", chan, ret);
		return ret;
	}
	ret = tisci_cmd_rm_psil_pair(dmsc, NAVSS_ID, PSIL_SRC(chan), PSIL_DST(chan));
	if (ret) {
		LOG_ERR("dma: PSI-L pair %#x -> %#x failed (%d)", PSIL_SRC(chan), PSIL_DST(chan), ret);
		return ret;
	}
	sys_write32(CHAN_RT_CTL_EN, RCHAN_RT(chan) + CHAN_RT_CTL);
	sys_write32(CHAN_RT_CTL_EN, TCHAN_RT(chan) + CHAN_RT_CTL);
	tx_widx = 0;
	cq_ridx = 0;
	LOG_INF("dma: UDMA channel %u, transmit ring %u, completion ring %u", chan, chan, cq_ring);
	return 0;
}

void dma_stop(void)
{
	if (!ready) {
		return;
	}
	sys_write32(0, TCHAN_RT(chan) + CHAN_RT_CTL);
	sys_write32(0, RCHAN_RT(chan) + CHAN_RT_CTL);
	ready = false;
}

static void tr_fill(volatile struct tr15 *tr, uint64_t dst, uint64_t src, uint32_t len,
		    bool last)
{
	tr->flags = TR_TYPE15 | TR_WAIT | TR_CSF_SUPR_EVT | (last ? TR_CSF_EOP : 0u);
	tr->addr = src;
	tr->icnt0 = len;
	tr->icnt1 = 1;
	tr->icnt2 = 1;
	tr->icnt3 = 1;
	tr->dim1 = len;
	tr->daddr = dst;
	tr->dicnt0 = len;
	tr->dicnt1 = 1;
	tr->dicnt2 = 1;
	tr->dicnt3 = 1;
	tr->ddim1 = len;
}

/* One descriptor: the copy, and with bell the doorbell word after it. */
static int run(uint64_t dst, uint64_t src, uint32_t len, const uint64_t *bell, uint32_t value,
	       uint32_t *ns)
{
	volatile struct trdesc *d = &mem->desc;
	uint32_t ntr = bell ? 2u : 1u;
	uint32_t t0, waited;
	uint64_t got;
	int ret = 0;

	if (len == 0 || len > 0xffffu) {
		return -EINVAL;
	}
	k_mutex_lock(&lock, K_FOREVER);
	if (!ready) {
		ret = setup();
		ready = ret == 0;
	}
	if (ret) {
		goto out;
	}

	memset((void *)d, 0, sizeof(*d));
	d->info0 = INFO0_TYPE_TR | (ntr - 1u); /* the last TR's index */
	d->info1 = INFO1_RECSIZE_64B | INFO1_PKTID(0) | INFO1_FLOWID_NONE;
	d->info2 = cq_ring; /* return ring */
	tr_fill(&d->tr[0], dst, src, len, ntr == 1u);
	if (bell) {
		mem->bell = value;
		tr_fill(&d->tr[1], *bell, (uint64_t)(uintptr_t)&mem->bell, sizeof(uint32_t), true);
	}
	barrier_dmem_fence_full();

	t0 = sys_read32(AI64_GTC_ADDR + 8u);
	mem->tx_ring[tx_widx] = (uint64_t)(uintptr_t)d;
	tx_widx = (tx_widx + 1u) % RING_ELEMS;
	barrier_dmem_fence_full();
	sys_write32(1, RING_RT(chan) + RING_RT_DB);

	/* The descriptor comes back on the completion ring. */
	while ((sys_read32(RING_RT(cq_ring) + RING_RT_OCC) & 0x1fffffu) == 0) {
		waited = sys_read32(AI64_GTC_ADDR + 8u) - t0;
		if (waited > AI64_GTC_HZ / 10u) {
			LOG_ERR("dma: no completion in 100 ms");
			ready = false;
			ret = -ETIMEDOUT;
			goto out;
		}
	}
	waited = sys_read32(AI64_GTC_ADDR + 8u) - t0;
	got = mem->cq_ring[cq_ridx];
	cq_ridx = (cq_ridx + 1u) % RING_ELEMS;
	sys_write32((uint32_t)-1, RING_RT(cq_ring) + RING_RT_DB);
	if (got != (uint64_t)(uintptr_t)d) {
		LOG_ERR("dma: completion %#llx is not the descriptor", (unsigned long long)got);
		ret = -EIO;
		goto out;
	}
	if (ns) {
		*ns = waited * (1000000000u / AI64_GTC_HZ);
	}
out:
	k_mutex_unlock(&lock);
	return ret;
}

int dma_copy(uint64_t dst, uint64_t src, uint32_t len, uint32_t *ns)
{
	return run(dst, src, len, NULL, 0, ns);
}

int dma_copy_bell(uint64_t dst, uint64_t src, uint32_t len, uint64_t bell, uint32_t value,
		  uint32_t *ns)
{
	return run(dst, src, len, &bell, value, ns);
}
```

## src/dma.h
```c
/* SPDX-License-Identifier: MIT */
#ifndef DMA_H_
#define DMA_H_

#include <stdint.h>

/*
 * Copy len bytes (1 to 65535) from SoC address src to dst with R5F0_0's
 * UDMA channel (dma.c), and wait for it. *ns, if not NULL, gets
 * the time from the doorbell to the completion. Returns 0 or a negative
 * errno.
 */
int dma_copy(uint64_t dst, uint64_t src, uint32_t len, uint32_t *ns);

/* The same, then the 32-bit value written at SoC address bell, by the UDMA
 * once the copy has landed. */
int dma_copy_bell(uint64_t dst, uint64_t src, uint32_t len, uint64_t bell, uint32_t value,
		  uint32_t *ns);

/* Turn the channel off, for a core about to stop (its shutdown hook, main.c). */
void dma_stop(void);

#endif
```

## src/pipe_dma.c
```c
/* SPDX-License-Identifier: MIT */
/*
 * R5F0_0's stage of the pipeline (ai64_pipe.h): every window of P8.31
 * samples, from ICSSG0's shared RAM into a C66x's L2 SRAM, with the UDMA:
 * the even windows to C66x 0, the odd ones to C66x 1. A window ends every
 * 512 us, and an FFT takes about 90 us, so either core alone would keep
 * up; splitting them leaves each the time for Linux's FIR jobs as well.
 *
 * ICSSG0 RTU1 rings FIFO 15 of this core's home mailbox (cluster 11, user
 * 1) with each window's number, while Linux has the pipeline running. The
 * interrupt only wakes the thread, which copies every window from the last
 * it copied to the newest, as long as the ring still holds them. Each copy
 * is one UDMA descriptor: the window's chunks and tag into slot
 * AI64_PIPE_IN_SLOT(window), then one past the window's number into that
 * C66x's doorbell word, which the UDMA writes only once the chunks have
 * landed (dma_copy_bell()). The C66x polls that word in its own L2.
 */

#include <zephyr/kernel.h>
#include <zephyr/device.h>
#include <zephyr/drivers/mbox.h>
#include <zephyr/sys/sys_io.h>
#include <zephyr/logging/log.h>
#include <stddef.h>

#include "ai64_pipe.h"
#include "dma.h"
#include "r5f0_0.h"

LOG_MODULE_DECLARE(ai64_r5, LOG_LEVEL_INF);

#define PIPE ((volatile struct ai64_pipe *)AI64_PIPE_ADDR)
#define SMEM_TAG(w) \
	((volatile struct ai64_pipe_tag *)(AI64_PIPE_SMEM_SOC + \
					   ((w) % AI64_PIPE_SLOTS) * AI64_PIPE_SLOT_SIZE + \
					   offsetof(struct ai64_pipe_slot, tag)))

static const struct device *const mbox = DEVICE_DT_GET(DT_NODELABEL(ai64_ipc_home0));
static K_SEM_DEFINE(bell, 0, 1);
/* One more than the newest window RTU1 rang about. */
static atomic_t newest;

static uint32_t gtc_lo(void)
{
	return sys_read32(AI64_GTC_ADDR + 8u);
}

static void rung(const struct device *dev, mbox_channel_id_t channel, void *user_data,
		 struct mbox_msg *msg)
{
	ARG_UNUSED(dev);
	ARG_UNUSED(channel);
	ARG_UNUSED(user_data);

	atomic_set(&newest, (atomic_val_t)(*(const uint32_t *)msg->data + 1u));
	k_sem_give(&bell);
}

/* Copy window w on; 0, or a negative errno. */
static int pass_on(volatile struct ai64_pipe_stage *st, uint32_t w)
{
	static uint32_t weights;
	uint64_t c66x = AI64_PIPE_C66X_PHYS(w % 2u);
	uint64_t dst = c66x + offsetof(struct ai64_pipe_c66x_in, slot) +
		       AI64_PIPE_IN_SLOT(w) * sizeof(struct ai64_pipe_slot);
	uint64_t src = AI64_PIPE_SMEM_SOC + (w % AI64_PIPE_SLOTS) * AI64_PIPE_SLOT_SIZE;
	uint32_t t_end, t0, t1;
	int ret;

	/* PRU1 has gone round the ring past it, or RTU1 has not stamped it. */
	if (SMEM_TAG(w)->win != w) {
		st->dropped++;
		return -ESTALE;
	}
	t_end = SMEM_TAG(w)->t_end_lo;
	t0 = gtc_lo();
	ret = dma_copy_bell(dst, src, AI64_PIPE_SLOT_COPY,
			    c66x + offsetof(struct ai64_pipe_c66x_in, ready),
			    w + 1u, NULL);
	t1 = gtc_lo();
	if (ret) {
		st->errors++;
		return ret;
	}
	if (PIPE->ctl.weights_seq != weights) {
		weights = PIPE->ctl.weights_seq;
		ai64_pipe_stage_reset(st);
	}
	ai64_pipe_stage_count(st, w, t1 - t_end, t1 - t0);
	return 0;
}

static void pipe_thread(void *a, void *b, void *c)
{
	volatile struct ai64_pipe_stage *st = &PIPE->stage[AI64_PIPE_DMA];
	uint32_t next = 0, end;
	bool started = false;
	int ret;

	ARG_UNUSED(a);
	ARG_UNUSED(b);
	ARG_UNUSED(c);

	ai64_pipe_stage_reset(st);
	ret = mbox_register_callback(mbox, AI64_PIPE_FIFO, rung, NULL);
	ret = ret ? ret : mbox_set_enabled(mbox, AI64_PIPE_FIFO, true);
	if (ret) {
		LOG_ERR("pipe: mailbox FIFO %u: %d", AI64_PIPE_FIFO, ret);
		return;
	}
	LOG_INF("pipe: windows from ICSSG0 to the C66x cores' L2 by UDMA, on RTU1's doorbell");

	for (;;) {
		k_sem_take(&bell, K_FOREVER);
		end = (uint32_t)atomic_get(&newest);
		/*
		 * The first window, after a stop, or after PRU1 started again:
		 * start from the newest.
		 */
		if (!started || (int32_t)(end - next) <= 0 || end - next > AI64_PIPE_SLOTS - 1u) {
			next = end - 1u;
			started = true;
		}
		for (; next != end; next++) {
			ret = pass_on(st, next);
			if (ret == -ESTALE) {
				continue;
			}
			if (ret) {
				LOG_ERR("pipe: window %u: DMA failed (%d)", next, ret);
				next = end;
				break;
			}
		}
	}
}

static K_THREAD_STACK_DEFINE(pipe_stack, 1024);
static struct k_thread pipe_tid;

void pipe_dma_start(void)
{
	k_thread_create(&pipe_tid, pipe_stack, K_THREAD_STACK_SIZEOF(pipe_stack), pipe_thread,
			NULL, NULL, NULL, K_PRIO_PREEMPT(2), 0, K_NO_WAIT);
	k_thread_name_set(&pipe_tid, "pipe_dma");
}
```

## src/r5f0_0.h
```c
/* SPDX-License-Identifier: MIT */
#ifndef R5F0_0_H_
#define R5F0_0_H_

#include <stddef.h>
#include <stdint.h>

#include "ai64_ipc.h"

/* SPI7, spi.c: write buf, 0 or a negative errno. */
int spi7_write(const void *buf, size_t len);
void spi7_status(char *buf, size_t len);
void spi7_request(const char *who, const struct ai64_ipc_msg *req, struct ai64_ipc_msg *rep);
/* Writes "hello". */
void spi7_start(void);

/* Linux's takeChunk and dmaCopy, on the bulk buffer (bulk.c). */
uint32_t bulk_chunk(uint32_t seq, uint32_t length, uint32_t crc);
int32_t bulk_dma(uint32_t dst, uint32_t src, uint32_t length, uint32_t *cpu_ns);

/* The pipeline's stage, pipe_dma.c: starts its thread. */
void pipe_dma_start(void);

#endif
```

## src/spi.c
```c
/* SPDX-License-Identifier: MIT */
/*
 * R5F0_0's job: SPI7 on header P9 (P9.31 CLK, P9.28 CS0, P9.30 MOSI), 1 MHz,
 * mode 0, MSB first, through Zephyr's McSPI driver. It writes "hello" at
 * boot, and then what Linux (spiWrite) or another core (an AI64_IPC_SPI
 * request) asks for.
 */

#include <zephyr/kernel.h>
#include <zephyr/device.h>
#include <zephyr/drivers/spi.h>
#include <zephyr/logging/log.h>
#include <errno.h>
#include <stdio.h>
#include <string.h>

#include "ai64_ipc.h"
#include "r5f0_0.h"

LOG_MODULE_DECLARE(ai64_r5, LOG_LEVEL_INF);

static const struct device *const spi = DEVICE_DT_GET(DT_NODELABEL(main_spi7));

static K_MUTEX_DEFINE(lock);
static uint32_t transfers, bytes;

int spi7_write(const void *buf, size_t len)
{
	static const struct spi_config cfg = {
		.frequency = 1000000,
		.operation = SPI_OP_MODE_CONTROLLER | SPI_WORD_SET(8) | SPI_TRANSFER_MSB,
		.peripheral = 0,
	};
	const struct spi_buf txb = {
		.buf = (void *)buf,
		.len = len,
	};
	const struct spi_buf_set tx = {
		.buffers = &txb,
		.count = 1,
	};
	int ret;

	if (!buf || !len) {
		return -EINVAL;
	}
	if (!device_is_ready(spi)) {
		LOG_ERR("spi7 not ready");
		return -ENODEV;
	}
	k_mutex_lock(&lock, K_FOREVER);
	ret = spi_write(spi, &cfg, &tx);
	if (ret == 0) {
		transfers++;
		bytes += len;
	}
	k_mutex_unlock(&lock);
	return ret;
}

void spi7_status(char *buf, size_t len)
{
	k_mutex_lock(&lock, K_FOREVER);
	snprintf(buf, len, "SPI7: %u writes, %u bytes", transfers, bytes);
	k_mutex_unlock(&lock);
}

void spi7_request(const char *who, const struct ai64_ipc_msg *req, struct ai64_ipc_msg *rep)
{
	size_t n;

	ARG_UNUSED(who);
	if (req->op != AI64_IPC_SPI) {
		return;
	}
	n = strnlen(req->text, sizeof(req->text) - 1u);
	rep->ret = spi7_write(req->text, n);
	rep->arg0 = rep->ret ? 0u : n;
}

void spi7_start(void)
{
	static const uint8_t hello[] = {'h', 'e', 'l', 'l', 'o'};
	int ret = spi7_write(hello, sizeof(hello));

	if (ret) {
		LOG_ERR("spi7 hello failed: %d", ret);
		return;
	}
	LOG_INF("spi7 hello wrote %u bytes", (unsigned int)sizeof(hello));
}
```
