## CMakeLists.txt
```
# SPDX-License-Identifier: MIT
#
# R5F1_1: the monitor, which pings the other three cores.
# The part every core runs is in ../common/ (common.cmake).
cmake_minimum_required(VERSION 3.20.0)

# Every core's settings and devicetree bindings, then this core's own.
set(CONF_FILE ${CMAKE_CURRENT_LIST_DIR}/../common/common.conf ${CMAKE_CURRENT_LIST_DIR}/prj.conf)
list(APPEND DTS_ROOT ${CMAKE_CURRENT_LIST_DIR}/../common)

find_package(Zephyr REQUIRED HINTS $ENV{ZEPHYR_BASE})

project(ai64_r5f1_1 C CXX)

include(${CMAKE_CURRENT_LIST_DIR}/../common/common.cmake)

target_sources(app PRIVATE
  src/main.c
  src/monitor.c
)
```

## Kconfig
```
# SPDX-License-Identifier: MIT

config AI64_MONITOR_PERIOD_MS
	int "How often the monitor pings every core, in milliseconds"
	default 100

source "Kconfig.zephyr"
```

## prj.conf
```kconfig
# The ELF is build/zephyr/r5f1_1/zephyr/ai64_r5f1_1.elf. That is not the
# kernel's default name (j7-main-r5f1_1-fw), so the core stays off at boot
# until ai64-demo starts it.
CONFIG_KERNEL_BIN_NAME="ai64_r5f1_1"

# This core has no console UART. Its log goes to a RAM buffer that the
# resource table lists as a trace, so Linux reads it at
# /sys/kernel/debug/remoteproc/remoteprocN/trace0.
CONFIG_CONSOLE=y
CONFIG_RAM_CONSOLE=y
CONFIG_LOG_MODE_MINIMAL=y
```

## app.overlay
```dts
// SPDX-License-Identifier: MIT
#include <zephyr/dt-bindings/interrupt-controller/ti-vim.h>

/*
 * TI-SCI, the device manager's API. Zephyr's TI-SCI driver talks to it over
 * this host's (42) threads on main_sec_proxy0: 93 (low_priority,
 * write) and 91 (response, read; k3conf show threads). The polled mailbox
 * driver in common/src/sproxy.c carries it, since no secure proxy interrupt
 * reaches an R5F here. reg is the device manager's debug window, which the
 * binding asks for and nothing reads.
 */
/ {
	ai64_sproxy: mailbox@32c00000 {
		compatible = "ai64,secure-proxy-poll";
		reg = <0x32c00000 0x100000>, <0x32400000 0x100000>;
		reg-names = "target_data", "rt";
		#mbox-cells = <1>;
	};

	dmsc: system-controller@44083000 {
		compatible = "ti,k2g-sci";
		reg = <0x44083000 0x1000>;
		ti,host-id = <42>;
		mboxes = <&ai64_sproxy 91>, <&ai64_sproxy 93>;
		mbox-names = "rx", "tx";
	};
};

/*
 * The mailbox interrupt route this core asks the device manager for at boot
 * (common/src/tisci.c), through Zephyr's TI-SCI driver.
 * NAVSS0_MAILBOX_2 user 2 arrives on NAVSS0_INTR_ROUTER_0
 * (device 213) input 430. Output 292 is the first of this host's range
 * (k3conf dump rm 213) and lands on this core's VIM input 228.
 */
/ {
	ai64_tisci: tisci-route {
		compatible = "ai64,tisci-irq-route";
		ir-id = <213>;
		ir-input = <430>;
		ir-output = <292>;
	};
};

/* The board puts the mailbox on VIM 256, which nothing routes to. */
&mbox2 {
	interrupts = <0 228 IRQ_TYPE_LEVEL IRQ_DEFAULT_PRIORITY>;
};

/*
 * The links to the other three R5F cores (common/ai64_ipc.dtsi). This core's
 * doorbells are NAVSS0_MAILBOX_10 user 3, which arrives on router input
 * 399 (TI-SCI's pend_intr 2); output 293, the next of this host's range,
 * lands on VIM input 229.
 */
#define AI64_IPC_SELF 3
#include "../common/ai64_ipc.dtsi"

/ {
	ai64_tisci_ipc: tisci-route-ipc {
		compatible = "ai64,tisci-irq-route";
		ir-id = <213>;
		ir-input = <399>;
		ir-output = <293>;
	};

	AI64_IPC_LINK(3, 0)
	AI64_IPC_LINK(3, 1)
	AI64_IPC_LINK(3, 2)
};
```

## src/main.c
```c
/* SPDX-License-Identifier: MIT */
/*
 * R5F1_1: the monitor (monitor.c). It pings the other three cores over
 * their ipc_service links, collects their status lines, and answers
 * Linux's status call with the table.
 *
 * Like every R5F core it also runs ../common/: RPMsg and eRPC to Linux,
 * ipc_service links to the other three, and its fabric node. ai64_r5_core
 * below is what this core adds to that, and start() starts its own job.
 */

#include <zephyr/kernel.h>
#include <zephyr/init.h>
#include <zephyr/logging/log.h>

#include "ai64_r5.h"
#include "r5f1_1.h"

LOG_MODULE_DECLARE(ai64_r5, LOG_LEVEL_INF);

const struct ai64_r5_core ai64_r5_core = {
	.status = monitor_status,
	.status_all = monitor_table,
};

/* At the APPLICATION init level: after the drivers, before main() and the
 * common threads. */
static int start(void)
{
	monitor_start();
	return 0;
}

SYS_INIT(start, APPLICATION, CONFIG_APPLICATION_INIT_PRIORITY);

int main(void)
{
	LOG_INF("ai64 " AI64_CORE " hello");
	return 0;
}
```

## src/monitor.c
```c
/* SPDX-License-Identifier: MIT */
/*
 * R5F1_1's job: keep an eye on the other three R5F cores.
 *
 * Every CONFIG_AI64_MONITOR_PERIOD_MS it pings each of them over its
 * ipc_service link and times the round trip on the GTC: request out,
 * through the peer's icmsg work queue and its request thread, reply back.
 * Once a second it also asks each for its status line. Linux's status call
 * to this core returns the whole table (monitor_table()).
 */

#include <zephyr/kernel.h>
#include <zephyr/sys/sys_io.h>
#include <zephyr/logging/log.h>
#include <stdio.h>
#include <string.h>

#include "ai64_ipc.h"
#include "ai64_shm.h"
#include "r5f1_1.h"

LOG_MODULE_DECLARE(ai64_r5, LOG_LEVEL_INF);

#define PERIOD_MS     CONFIG_AI64_MONITOR_PERIOD_MS
#define STATUS_EVERY  (1000 / PERIOD_MS)
#define GTC_NS        (1000000000u / AI64_GTC_HZ)

struct seen {
	bool up;
	uint32_t pings, lost;
	/* Round trips over the last second, in GTC ticks. */
	uint32_t rtt_min, rtt_max, rtt_sum, rtt_n;
	uint32_t show_min, show_max, show_avg;
	char status[AI64_IPC_TEXT];
};

static struct seen seen[AI64_IPC_CORES];
static uint32_t rounds;
static K_MUTEX_DEFINE(lock);

void monitor_status(char *buf, size_t len)
{
	snprintf(buf, len, "monitor: pinging the other R5F cores every %u ms, %u rounds", PERIOD_MS,
		 rounds);
}

void monitor_table(char *buf, size_t len)
{
	size_t n;
	unsigned int c;

	monitor_status(buf, len);
	n = strlen(buf);
	k_mutex_lock(&lock, K_FOREVER);
	for (c = 0; c < AI64_IPC_CORES && n < len; c++) {
		const struct seen *s = &seen[c];

		if (c == AI64_SELF) {
			continue;
		}
		if (!s->up) {
			n += snprintf(buf + n, len - n, "\n  %s: link down, %u of %u pings lost",
				      ai64_core_name[c], s->lost, s->pings);
			continue;
		}
		n += snprintf(buf + n, len - n,
			      "\n  %s: round trip %u.%02u us (%u.%02u to %u.%02u), %u of %u lost; %s",
			      ai64_core_name[c], s->show_avg * GTC_NS / 1000u,
			      s->show_avg * GTC_NS % 1000u / 10u, s->show_min * GTC_NS / 1000u,
			      s->show_min * GTC_NS % 1000u / 10u, s->show_max * GTC_NS / 1000u,
			      s->show_max * GTC_NS % 1000u / 10u, s->lost, s->pings, s->status);
	}
	k_mutex_unlock(&lock);
}

static void ping(unsigned int c)
{
	struct ai64_ipc_msg m = {.op = AI64_IPC_PING};
	struct seen *s = &seen[c];
	int ret;

	ret = ai64_ipc_call(c, &m, K_MSEC(20));
	k_mutex_lock(&lock, K_FOREVER);
	s->pings++;
	if (ret) {
		s->lost++;
		s->up = ai64_ipc_bound(c);
	} else {
		/* The reply carries our send time back; arrival is now. */
		uint32_t rtt = sys_read32(AI64_GTC_ADDR + 8u) - m.sent;

		s->up = true;
		if (s->rtt_n == 0u || rtt < s->rtt_min) {
			s->rtt_min = rtt;
		}
		if (rtt > s->rtt_max) {
			s->rtt_max = rtt;
		}
		s->rtt_sum += rtt;
		s->rtt_n++;
	}
	k_mutex_unlock(&lock);
}

static void ask_status(unsigned int c)
{
	struct ai64_ipc_msg m = {.op = AI64_IPC_STATUS};
	struct seen *s = &seen[c];
	int ret = ai64_ipc_call(c, &m, K_MSEC(50));

	k_mutex_lock(&lock, K_FOREVER);
	if (ret == 0) {
		strncpy(s->status, m.text, sizeof(s->status) - 1u);
	} else {
		snprintf(s->status, sizeof(s->status), "no status (%d)", ret);
	}
	if (s->rtt_n) {
		s->show_min = s->rtt_min;
		s->show_max = s->rtt_max;
		s->show_avg = s->rtt_sum / s->rtt_n;
	}
	s->rtt_n = 0;
	s->rtt_sum = 0;
	s->rtt_max = 0;
	k_mutex_unlock(&lock);
}

static void monitor_thread(void *a, void *b, void *c)
{
	static char line[512];
	unsigned int n;

	ARG_UNUSED(a);
	ARG_UNUSED(b);
	ARG_UNUSED(c);

	for (;;) {
		k_msleep(PERIOD_MS);
		for (n = 0; n < AI64_IPC_CORES; n++) {
			if (n != AI64_SELF) {
				ping(n);
			}
		}
		if (++rounds % STATUS_EVERY == 0u) {
			for (n = 0; n < AI64_IPC_CORES; n++) {
				if (n != AI64_SELF) {
					ask_status(n);
				}
			}
		}
		/* Every 10 s, the table in this core's trace. */
		if (rounds % (10u * STATUS_EVERY) == 0u) {
			monitor_table(line, sizeof(line));
			LOG_INF("%s", line);
		}
	}
}

static K_THREAD_STACK_DEFINE(monitor_stack, 2048);
static struct k_thread monitor_tid;

void monitor_start(void)
{
	k_thread_create(&monitor_tid, monitor_stack, K_THREAD_STACK_SIZEOF(monitor_stack),
			monitor_thread, NULL, NULL, NULL, 10, 0, K_NO_WAIT);
	k_thread_name_set(&monitor_tid, "monitor");
}
```

## src/r5f1_1.h
```c
/* SPDX-License-Identifier: MIT */
#ifndef R5F1_1_H_
#define R5F1_1_H_

#include <stddef.h>

/* The monitor, monitor.c: its own status line, and that line with one for
 * each other core, for Linux's status call. */
void monitor_status(char *buf, size_t len);
void monitor_table(char *buf, size_t len);
/* Starts its thread. */
void monitor_start(void);

#endif
```
