## CMakeLists.txt
```
# SPDX-License-Identifier: MIT
#
# R5F0_1: EHRPWM4 on P9.25, and the pipeline's last stage.
# The part every core runs is in ../common/ (common.cmake).
cmake_minimum_required(VERSION 3.20.0)

# Every core's settings and devicetree bindings, then this core's own.
set(CONF_FILE ${CMAKE_CURRENT_LIST_DIR}/../common/common.conf ${CMAKE_CURRENT_LIST_DIR}/prj.conf)
list(APPEND DTS_ROOT ${CMAKE_CURRENT_LIST_DIR}/../common)

find_package(Zephyr REQUIRED HINTS $ENV{ZEPHYR_BASE})

project(ai64_r5f0_1 C CXX)

include(${CMAKE_CURRENT_LIST_DIR}/../common/common.cmake)

target_sources(app PRIVATE
  src/main.c
  src/pwm.c
  src/pipe_pwm.c
)
```

## prj.conf
```kconfig
# The ELF is build/zephyr/r5f0_1/zephyr/ai64_r5f0_1.elf. That is not the
# kernel's default name (j7-main-r5f0_1-fw), so the core stays off at boot
# until ai64-demo starts it.
CONFIG_KERNEL_BIN_NAME="ai64_r5f0_1"

# EHRPWM4 on P9.25 (src/pwm.c). The device manager gives it its clock and
# power, over TI-SCI; the power domain turns it on at boot.
CONFIG_PWM=y
CONFIG_CLOCK_CONTROL=y
CONFIG_POWER_DOMAIN=y
CONFIG_POWER_DOMAIN_TISCI_INIT_PRIORITY=20

# This core has no console UART. Its log goes to a RAM buffer that the
# resource table lists as a trace, so Linux reads it at
# /sys/kernel/debug/remoteproc/remoteprocN/trace0.
CONFIG_CONSOLE=y
CONFIG_RAM_CONSOLE=y
CONFIG_LOG_MODE_MINIMAL=y
```

## app.overlay
```dts
// SPDX-License-Identifier: MIT
#include <zephyr/dt-bindings/pinctrl/ti-k3-pinctrl.h>
#include <zephyr/dt-bindings/interrupt-controller/ti-vim.h>
#include <zephyr/dt-bindings/pwm/pwm.h>

/*
 * R5F0_1's job: EHRPWM4 output B on P9.25 (src/pwm.c).
 *
 * 0x200000 is the pad's TX-disable bit (PIN_DISABLE in the Linux header),
 * OR mux mode 7, so the shorted partner ball stays off. The K3 pinctrl
 * helper applies only the first two pinmux cells of each group, so each
 * group has one pin.
 */
#define AI64_PIN_OFF 0x200000

&pinctrl {
	ai64_epwm4_b: ai64-epwm4-b {
		/* P9.25b W26 RGMII6_RXC.EHRPWM4_B, mode 6 */
		pinmux = <K3_PINMUX(0x01a4, PIN_OUTPUT, MUX_MODE_6)>;
	};
	ai64_epwm4_off_p9_25a: ai64-epwm4-off-p9-25a {
		/* P9.25a AC4, shorted to P9.25b */
		pinmux = <K3_PINMUX(0x0200, AI64_PIN_OFF, MUX_MODE_7)>;
	};
};

/*
 * Zephyr's EHRPWM driver (ti,am3352-ehrpwm). Its functional clock and power
 * come from the device manager over TI-SCI (dmsc, below): device 87, clock
 * 0, as in the Linux device tree's main_ehrpwm4. The power domain turns the
 * module on at boot. The time-base clock gate is CTRLMMR_EPWM4_CTRL bit 0,
 * at 0x4150 in CTRL_MMR0 (Linux's ehrpwm_tbclk 4), in the partition that
 * kicks at 0x5008. Linux leaves EHRPWM4 alone once install-beagle.sh has
 * taken the stock image's epwm4 overlay out of its boot entry.
 * src/pwm.c drives it, through the pwms of /zephyr,user.
 */
/ {
	main_ctrl_mmr0: syscon@100000 {
		compatible = "ti,control-module", "syscon";
		reg = <0x00100000 0x1c000>;
		ti,unlock-offsets = <0x5008>;
		#epwm-tbclk-cells = <2>;
	};

	power-domains {
		epwm4_pd: epwm4-pd {
			compatible = "ti,sci-pm-domain";
			tisci,device-id = <87>;
			tisci,device-mode = "EXCLUSIVE";
			#power-domain-cells = <0>;
		};
	};

	main_ehrpwm4: pwm@3040000 {
		compatible = "ti,am3352-ehrpwm";
		reg = <0x03040000 0x100>;
		clocks = <&k3_clks 87 0>;
		tbclk = <&main_ctrl_mmr0 0x4150 0>;
		power-domains = <&epwm4_pd>;
		pinctrl-0 = <&ai64_epwm4_b &ai64_epwm4_off_p9_25a>;
		pinctrl-names = "default";
		#pwm-cells = <3>;
	};

	zephyr,user {
		/* Output B is channel 1. 1 kHz until the steps start. */
		pwms = <&main_ehrpwm4 1 PWM_MSEC(1) PWM_POLARITY_NORMAL>;
	};
};

/*
 * TI-SCI, the device manager's API. Zephyr's TI-SCI driver talks to it over
 * this host's (37) threads on main_sec_proxy0: 73 (low_priority,
 * write) and 71 (response, read; k3conf show threads). The polled mailbox
 * driver in common/src/sproxy.c carries it, since no secure proxy interrupt
 * reaches an R5F here. reg is the device manager's debug window, which the
 * binding asks for and nothing reads.
 */
/ {
	ai64_sproxy: mailbox@32c00000 {
		compatible = "ai64,secure-proxy-poll";
		reg = <0x32c00000 0x100000>, <0x32400000 0x100000>;
		reg-names = "target_data", "rt";
		#mbox-cells = <1>;
	};

	dmsc: system-controller@44083000 {
		compatible = "ti,k2g-sci";
		reg = <0x44083000 0x1000>;
		ti,host-id = <37>;
		mboxes = <&ai64_sproxy 71>, <&ai64_sproxy 73>;
		mbox-names = "rx", "tx";

		k3_clks: clock-controller {
			compatible = "ti,k2g-sci-clk";
			#clock-cells = <2>;
		};
	};
};

/*
 * The mailbox interrupt routes this core asks the device manager for at
 * boot (common/src/tisci.c), through Zephyr's TI-SCI driver, both on
 * NAVSS0_INTR_ROUTER_0 (device 213), whose outputs 228 to 255 are this
 * host's (k3conf dump rm 213) and land on this core's VIM inputs 228 to 255:
 * - Linux's doorbell, NAVSS0_MAILBOX_1 user 1: router input 433, output 228,
 *   VIM 228.
 * - The other R5F cores' doorbells, NAVSS0_MAILBOX_10 user 1
 *   (common/ai64_ipc.dtsi): router input 397 (TI-SCI's pend_intr 0),
 *   output 229, VIM 229.
 */
/ {
	ai64_tisci: tisci-route {
		compatible = "ai64,tisci-irq-route";
		ir-id = <213>;
		ir-input = <433>;
		ir-output = <228>;
	};

	ai64_tisci_ipc: tisci-route-ipc {
		compatible = "ai64,tisci-irq-route";
		ir-id = <213>;
		ir-input = <397>;
		ir-output = <229>;
	};
};

/* The board puts the mailbox on VIM 256, which nothing routes to. */
&mbox1 {
	interrupts = <0 228 IRQ_TYPE_LEVEL IRQ_DEFAULT_PRIORITY>;
};

#define AI64_IPC_SELF 1
#include "../common/ai64_ipc.dtsi"

/ {
	AI64_IPC_LINK(1, 0)
	AI64_IPC_LINK(1, 2)
	AI64_IPC_LINK(1, 3)
};
```

## src/main.c
```c
/* SPDX-License-Identifier: MIT */
/*
 * R5F0_1: P9.25, EHRPWM4 output B (pwm.c), which Linux, the other cores,
 * and fabric routes set; and the pipeline's last stage (pipe_pwm.c), which
 * sets P9.25 to the class the C7x finds for each window.
 *
 * Like every R5F core it also runs ../common/: RPMsg and eRPC to Linux,
 * ipc_service links to the other three, and its fabric node. ai64_r5_core
 * below is what this core adds to that, and start() starts its own job.
 */

#include <zephyr/kernel.h>
#include <zephyr/init.h>
#include <zephyr/logging/log.h>

#include "ai64_r5.h"
#include "r5f0_1.h"

LOG_MODULE_DECLARE(ai64_r5, LOG_LEVEL_INF);

const struct ai64_r5_core ai64_r5_core = {
	.status = p925_status,
	.request = p925_request,
	.fab_action = p925_fab_action,
	.fab_tick = p925_publish,
};

/* At the APPLICATION init level: after the drivers, before main() and the
 * common threads. */
static int start(void)
{
	p925_start();
	pipe_pwm_start();
	return 0;
}

SYS_INIT(start, APPLICATION, CONFIG_APPLICATION_INIT_PRIORITY);

int main(void)
{
	LOG_INF("ai64 " AI64_CORE " hello");
	return 0;
}
```

## src/pipe_pwm.c
```c
/* SPDX-License-Identifier: MIT */
/*
 * R5F0_1's stage of the pipeline (ai64_pipe.h), the last: the class the
 * C7x found for each window, on P9.25.
 *
 * The C7x writes its verdict into the result ring in DDR, then rings FIFO
 * 15 of this core's home mailbox (cluster 10, user 1) with the window's
 * number; the thread takes every window from the last it took to that
 * one, in order. While Linux asks it to follow, it holds P9.25 on the
 * class's frequency and duty (p925_class()), changing it only when the
 * class changes, and only to a class two windows in a row agree on. A
 * window that falls across a step change can match a third class: half a
 * window of 20 kHz at 90% and half of 10 kHz at 10% have the spectrum of
 * 10 kHz at 90% or 10%, and a DC in between. The windows overlap by half,
 * so two fall across each change, but one is mostly the old step and the
 * other mostly the new, and they do not agree. So P9.25 makes no step the
 * input did not. A pwm or steps request from anyone else ends that, until
 * Linux starts the pipeline again. Either way it keeps score: the input
 * steps on the GTC's time, so each window's tag says which class it should
 * have been, unless a step change falls inside it. New weights start the
 * score again.
 */

#include <zephyr/kernel.h>
#include <zephyr/device.h>
#include <zephyr/drivers/mbox.h>
#include <zephyr/sys/sys_io.h>
#include <zephyr/logging/log.h>

#include "ai64_pipe.h"
#include "r5f0_1.h"

LOG_MODULE_DECLARE(ai64_r5, LOG_LEVEL_INF);

#define PIPE ((volatile struct ai64_pipe *)AI64_PIPE_ADDR)

/*
 * How far from a step change a window must end to be scored: the input
 * changes at the end of the period nearest the step's time, up to half
 * its longest period (50 us) off, and RTU1's stamp is up to a chunk (8 us)
 * late.
 */
#define MARGIN_GTC (60u * (AI64_GTC_HZ / 1000000u))

static const struct device *const mbox = DEVICE_DT_GET(DT_NODELABEL(ai64_ipc_home1));
static K_SEM_DEFINE(bell, 0, 1);
static atomic_t newest;

static uint32_t gtc_lo(void)
{
	return sys_read32(AI64_GTC_ADDR + 8u);
}

static void rung(const struct device *dev, mbox_channel_id_t channel, void *user_data,
		 struct mbox_msg *msg)
{
	ARG_UNUSED(dev);
	ARG_UNUSED(channel);
	ARG_UNUSED(user_data);

	atomic_set(&newest, (atomic_val_t)(*(const uint32_t *)msg->data + 1u));
	k_sem_give(&bell);
}

static void score_reset(volatile struct ai64_pipe_score *sc)
{
	uint32_t i, j;

	sc->magic = 0;
	sc->right = 0;
	sc->wrong = 0;
	sc->mixed = 0;
	sc->waits = 0;
	sc->changes = 0;
	for (i = 0; i < AI64_PIPE_CLASSES; i++) {
		for (j = 0; j < AI64_PIPE_CLASSES; j++) {
			sc->confusion[i][j] = 0;
		}
	}
	sc->magic = AI64_PIPE_MAGIC;
}

/* P9.25 is on a class this set; let go of it (someone else set it) until a new start. */
static bool following, let_go;
static uint32_t last_cls = UINT32_MAX, weights;

/* Window w, whose verdict the C7x has written; agreed: the window before had its class. */
static void one(volatile struct ai64_pipe_stage *st, volatile struct ai64_pipe_score *sc,
		uint32_t w, bool in_order)
{
	volatile struct ai64_pipe_result *r = &PIPE->result[w % AI64_PIPE_RESULTS];
	uint32_t t0 = gtc_lo(), t1, cls;
	uint64_t t_end;
	int32_t truth;
	bool agreed;

	if (r->win != w) {
		st->errors++;
		return;
	}
	cls = r->cls;
	agreed = in_order && cls == last_cls;
	last_cls = cls;
	t_end = ((uint64_t)r->t_end_hi << 32) | r->t_end_lo;

	if (PIPE->ctl.weights_seq != weights) {
		weights = PIPE->ctl.weights_seq;
		score_reset(sc);
		ai64_pipe_stage_reset(st);
		let_go = false;
	}
	if (following && !p925_following()) {
		LOG_INF("pipe: P9.25 was set by hand; the pipeline lets go of it");
		following = false;
		let_go = true;
		sc->cls = UINT32_MAX;
	}
	if (PIPE->ctl.magic == AI64_PIPE_MAGIC && PIPE->ctl.follow && !let_go) {
		if (cls == sc->cls) {
			/* Nothing to do. */
		} else if (!agreed) {
			sc->waits++;
		} else if (cls < AI64_PIPE_CLASSES) {
			if (p925_class(cls) == 0) {
				following = true;
				sc->cls = cls;
				sc->changes++;
			} else {
				st->errors++;
			}
		}
	} else if (following) {
		/* Linux stopped it: back to the program, in step with the others. */
		following = false;
		sc->cls = UINT32_MAX;
		(void)p925_steps("the pipeline", AI64_PWM_DEFAULT_STEPS_MS);
	} else if (!PIPE->ctl.follow) {
		let_go = false;
	}

	t1 = gtc_lo();

	truth = ai64_pipe_truth(t_end, PIPE->ctl.steps_ms, MARGIN_GTC);
	if (truth < 0 || cls >= AI64_PIPE_CLASSES) {
		sc->mixed++;
	} else {
		if ((uint32_t)truth == cls) {
			sc->right++;
		} else {
			sc->wrong++;
		}
		sc->confusion[truth][cls]++;
	}
	ai64_pipe_stage_count(st, w, t1 - (uint32_t)t_end, t1 - t0);
}

static void pipe_thread(void *a, void *b, void *c)
{
	volatile struct ai64_pipe_stage *st = &PIPE->stage[AI64_PIPE_PWM];
	volatile struct ai64_pipe_score *sc = &PIPE->score;
	uint32_t next = 0, end;
	bool started = false;
	int ret;

	ARG_UNUSED(a);
	ARG_UNUSED(b);
	ARG_UNUSED(c);

	weights = PIPE->ctl.weights_seq;
	ai64_pipe_stage_reset(st);
	score_reset(sc);
	sc->cls = UINT32_MAX;
	ret = mbox_register_callback(mbox, AI64_PIPE_FIFO, rung, NULL);
	ret = ret ? ret : mbox_set_enabled(mbox, AI64_PIPE_FIFO, true);
	if (ret) {
		LOG_ERR("pipe: mailbox FIFO %u: %d", AI64_PIPE_FIFO, ret);
		return;
	}
	LOG_INF("pipe: P9.25 from the C7x's classes, on its doorbell");

	for (;;) {
		bool in_order = true;

		k_sem_take(&bell, K_FOREVER);
		end = (uint32_t)atomic_get(&newest);
		/*
		 * The first window, or a jump: a stage started again, or the
		 * ring no longer holds them. Start from the newest.
		 */
		if (!started || (int32_t)(end - next) <= 0 || end - next > AI64_PIPE_RESULTS) {
			if (started && end - next < AI64_PIPE_RESYNC) {
				st->dropped += end - next - 1u;
			}
			next = end - 1u;
			started = true;
			in_order = false;
		}
		for (; next != end; next++) {
			one(st, sc, next, in_order);
			in_order = true;
		}
	}
}

static K_THREAD_STACK_DEFINE(pipe_stack, 1024);
static struct k_thread pipe_tid;

void pipe_pwm_start(void)
{
	k_thread_create(&pipe_tid, pipe_stack, K_THREAD_STACK_SIZEOF(pipe_stack), pipe_thread,
			NULL, NULL, NULL, K_PRIO_PREEMPT(2), 0, K_NO_WAIT);
	k_thread_name_set(&pipe_tid, "pipe_pwm");
}
```

## src/pwm.c
```c
/* SPDX-License-Identifier: MIT */
/*
 * R5F0_1's job: P9.25, EHRPWM4 output B, through Zephyr's EHRPWM driver,
 * on the pwms of /zephyr,user in this core's overlay.
 *
 * Linux sets it over eRPC (setPwm for a fixed duty, setPwmSteps), another
 * R5F core with an AI64_IPC_PWM or AI64_IPC_STEPS request (p925_request()),
 * any core with a fabric route's pwm or steps action for r5f0_1, and the
 * pipeline (pipe_pwm.c), which holds it on the class the C7x found. Like the
 * ICSSG0 slices it starts stepping through AI64_PWM_STEP_HZ and
 * AI64_PWM_STEP_PCT, a step every AI64_PWM_DEFAULT_STEPS_MS, on the GTC's
 * time (ai64_shm.h), so it changes step with them. A delayable work item
 * takes the steps. pwm_set() would ask the device manager for EHRPWM4's
 * clock rate over TI-SCI each time, which takes longer than a 20 kHz
 * period; the rate does not change, so this asks once and sets cycles.
 *
 * About every 10 ms the fabric thread publishes its
 * struct ai64_pwm_status (ai64_shm.h) in this node's fabric page, as the
 * ICSSG0 RTUs do for their PWM slices. The EHRPWM counts no periods, so
 * periods stays 0, and late does not apply.
 */

#include <zephyr/kernel.h>
#include <zephyr/drivers/pwm.h>
#include <zephyr/logging/log.h>

#include <stdio.h>

#include "ai64_fabric.h"
#include "ai64_ipc.h"
#include "ai64_shm.h"
#include "r5f0_1.h"

LOG_MODULE_DECLARE(ai64_r5, LOG_LEVEL_INF);

static const struct pwm_dt_spec out = PWM_DT_SPEC_GET(DT_PATH(zephyr_user));
static const uint32_t step_hz[AI64_PWM_STEP_FREQS] = AI64_PWM_STEP_HZ;
static const uint32_t step_pct[AI64_PWM_STEPS] = AI64_PWM_STEP_PCT;
static K_MUTEX_DEFINE(lock);
static uint32_t ask_period, ask_duty, run_period, run_duty, ctl_seq, ctl_ack;
/* EHRPWM4's clock, asked for once */
static uint64_t cycles_per_sec;
static uint32_t steps_ms, step_at;
/* Set from the pipeline's classes (p925_class()). */
static bool following;
/* The GTC low word when the next step begins. */
static uint32_t step_next;

static void step_work(struct k_work *work);
static K_WORK_DELAYABLE_DEFINE(step, step_work);

/* Set the outputs; the caller holds the lock. */
static int apply(uint32_t period_ns, uint32_t duty_ns)
{
	int ret = 0;

	if (cycles_per_sec == 0u) {
		ret = pwm_get_cycles_per_sec(out.dev, out.channel, &cycles_per_sec);
	}
	if (ret == 0) {
		ret = pwm_set_cycles(out.dev, out.channel,
				     (uint32_t)(period_ns * cycles_per_sec / NSEC_PER_SEC),
				     (uint32_t)(duty_ns * cycles_per_sec / NSEC_PER_SEC), out.flags);
	}
	if (ret == 0) {
		run_period = period_ns;
		run_duty = duty_ns;
		ctl_ack = ctl_seq;
	}
	return ret;
}

/* Step n of the 15: the frequency is n / 5, the duty n % 5. */
static int apply_step(uint32_t n)
{
	uint32_t period = 1000000000u / step_hz[n / AI64_PWM_STEPS];

	ask_period = period;
	return apply(period, (uint32_t)((uint64_t)period * step_pct[n % AI64_PWM_STEPS] / 100u));
}

static uint32_t gtc_lo(void)
{
	return sys_read32(AI64_GTC_ADDR + 8u);
}

static uint64_t gtc(void)
{
	uint32_t hi, lo;

	do {
		hi = sys_read32(AI64_GTC_ADDR + 12u);
		lo = gtc_lo();
	} while (sys_read32(AI64_GTC_ADDR + 12u) != hi);
	return ((uint64_t)hi << 32) | lo;
}

/*
 * When to set the next step, as a GTC low word. The EHRPWM takes a new
 * period and duty at the end of its period, so half a period before the
 * step's time puts the change on the period end nearest it.
 */
static uint32_t step_set_at(void)
{
	return step_next - (uint32_t)((uint64_t)run_period * AI64_GTC_HZ / 2000000000u);
}

#define GTC_PER_TICK (AI64_GTC_HZ / CONFIG_SYS_CLOCK_TICKS_PER_SEC)

/*
 * The work runs just after a kernel tick, so the GTC it reads is that
 * tick's time: it wakes next on the tick nearest the step's time, within
 * half a tick of it. A relative timeout would end on the tick after.
 */
static void step_work(struct k_work *work)
{
	uint32_t tick = gtc_lo();
	int32_t left;

	ARG_UNUSED(work);

	k_mutex_lock(&lock, K_FOREVER);
	if (steps_ms != 0u) {
		left = (int32_t)(step_set_at() - tick);
		/* A step is GTC time, so a late one is taken late, never skipped or doubled. */
		if (left < (int32_t)GTC_PER_TICK / 2) {
			step_at = step_at + 1u == AI64_PWM_STEP_FREQS * AI64_PWM_STEPS ? 0u : step_at + 1u;
			(void)apply_step(step_at);
			step_next += AI64_PWM_STEP_GTC(steps_ms);
			left = (int32_t)(step_set_at() - tick);
		}
		left = left < 0 ? 0 : left;
		k_work_reschedule(&step, K_TIMEOUT_ABS_TICKS(k_uptime_ticks() +
							      (left + GTC_PER_TICK / 2u) / GTC_PER_TICK));
	}
	k_mutex_unlock(&lock);
}

static uint32_t clamp_period(uint32_t period_ns)
{
	if (period_ns < AI64_PWM_HW_PERIOD_MIN_NS) {
		return AI64_PWM_HW_PERIOD_MIN_NS;
	}
	return period_ns > AI64_PWM_PERIOD_MAX_NS ? AI64_PWM_PERIOD_MAX_NS : period_ns;
}

int p925_set(const char *who, uint32_t period_ns, uint32_t duty_ns)
{
	int ret;

	period_ns = clamp_period(period_ns);
	if (duty_ns > period_ns) {
		duty_ns = period_ns;
	}
	if (!pwm_is_ready_dt(&out)) {
		LOG_ERR("pwm: EHRPWM4 is not ready");
		return -ENODEV;
	}
	k_mutex_lock(&lock, K_FOREVER);
	ask_period = period_ns;
	ask_duty = duty_ns;
	steps_ms = 0;
	following = false;
	(void)k_work_cancel_delayable(&step);
	ctl_seq++;
	ret = apply(period_ns, duty_ns);
	k_mutex_unlock(&lock);
	if (ret) {
		LOG_ERR("pwm: %s asked for P9.25 period %u ns duty %u ns, failed (%d)", who,
			period_ns, duty_ns, ret);
	} else {
		LOG_INF("pwm: %s set P9.25 (EHRPWM4_B) to period %u ns, duty %u ns", who,
			period_ns, duty_ns);
	}
	return ret;
}

int p925_steps(const char *who, uint32_t ms)
{
	if (!pwm_is_ready_dt(&out)) {
		LOG_ERR("pwm: EHRPWM4 is not ready");
		return -ENODEV;
	}
	if (ms > AI64_PWM_STEPS_MAX_MS) {
		ms = AI64_PWM_STEPS_MAX_MS;
	}
	k_mutex_lock(&lock, K_FOREVER);
	steps_ms = ms;
	following = false;
	ctl_seq++;
	if (ms != 0u) {
		/* The step the GTC is on now; the work, on the next tick, moves on from it. */
		step_at = ai64_pwm_step_at(gtc(), ms, &step_next);
		ask_duty = 0;
		(void)apply_step(step_at);
		k_work_reschedule(&step, K_TICKS(1));
	} else {
		(void)k_work_cancel_delayable(&step);
		ctl_ack = ctl_seq;
	}
	k_mutex_unlock(&lock);
	LOG_INF("pwm: %s set P9.25 (EHRPWM4_B) stepping 10, 15, 20 kHz x 10-90%% duty, every %u ms",
		who, ms);
	return 0;
}

int p925_class(uint32_t n)
{
	int ret;

	if (n >= AI64_PWM_STEP_FREQS * AI64_PWM_STEPS || !pwm_is_ready_dt(&out)) {
		return -EINVAL;
	}
	k_mutex_lock(&lock, K_FOREVER);
	if (steps_ms != 0u) {
		steps_ms = 0;
		(void)k_work_cancel_delayable(&step);
	}
	following = true;
	ctl_seq++;
	ask_duty = 0;
	ret = apply_step(n);
	k_mutex_unlock(&lock);
	return ret;
}

bool p925_following(void)
{
	return following;
}

void p925_publish(volatile void *page, uint32_t now)
{
	volatile struct ai64_pwm_status *s = page;

	k_mutex_lock(&lock, K_FOREVER);
	s->magic = 0;
	s->engine = AI64_PWM_EHRPWM;
	s->unit = 4;
	s->channel = out.channel;
	s->rpmsg = 1;
	s->ask_period_ns = following ? 0 : ask_period;
	s->ask_duty_ns = following ? 0 : ask_duty;
	s->ask_dead_ns = 0;
	s->sweep_ms = 0;
	s->steps_ms = steps_ms;
	s->run_period_ns = run_period;
	s->run_duty_ns = run_duty;
	s->run_dead_ns = 0;
	s->periods = 0;
	s->late = 0;
	s->late_max_ns = 0;
	s->ctl_seq = ctl_seq;
	s->ctl_ack = ctl_ack;
	s->at = now;
	s->magic = AI64_PWM_MAGIC;
	k_mutex_unlock(&lock);
}

void p925_status(char *buf, size_t len)
{
	k_mutex_lock(&lock, K_FOREVER);
	if (following) {
		snprintf(buf, len, "P9.25: following the pipeline, now %u Hz at %u%% duty",
			 run_period ? 1000000000u / run_period : 0u,
			 run_period ? (uint32_t)(((uint64_t)run_duty * 200u / run_period + 1u) / 2u) : 0u);
	} else if (steps_ms) {
		snprintf(buf, len, "P9.25: stepping every %u ms, now %u Hz at %u%% duty", steps_ms,
			 run_period ? 1000000000u / run_period : 0u,
			 run_period ? (uint32_t)(((uint64_t)run_duty * 200u / run_period + 1u) / 2u) : 0u);
	} else {
		snprintf(buf, len, "P9.25: fixed, period %u ns, duty %u ns", run_period, run_duty);
	}
	k_mutex_unlock(&lock);
}

void p925_request(const char *who, const struct ai64_ipc_msg *req, struct ai64_ipc_msg *rep)
{
	if (req->op == AI64_IPC_PWM) {
		rep->ret = p925_set(who, req->arg0, req->arg1);
	} else if (req->op == AI64_IPC_STEPS) {
		rep->ret = p925_steps(who, req->arg0);
	}
}

uint32_t p925_fab_action(uint32_t action, uint32_t arg0, uint32_t arg1)
{
	if (action == AI64_FAB_ACT_PWM) {
		return p925_set("A fabric route", arg0, arg1) ? 2u : 0u;
	}
	if (action == AI64_FAB_ACT_STEPS) {
		return p925_steps("A fabric route", arg0) ? 2u : 0u;
	}
	return 1u;
}

/* Stepping, from the start. */
void p925_start(void)
{
	(void)p925_steps("Zephyr", AI64_PWM_DEFAULT_STEPS_MS);
}
```

## src/r5f0_1.h
```c
/* SPDX-License-Identifier: MIT */
#ifndef R5F0_1_H_
#define R5F0_1_H_

#include <stdbool.h>
#include <stddef.h>
#include <stdint.h>

#include "ai64_ipc.h"

/* P9.25, pwm.c. who names the asker in the log. */
int p925_set(const char *who, uint32_t period_ns, uint32_t duty_ns);
/* ms 0 stops the steps and leaves the duty where it is. */
int p925_steps(const char *who, uint32_t ms);
/* Hold P9.25 on step n of the program, quietly: the pipeline's class n
 * (pipe_pwm.c). A set or steps request ends it. */
int p925_class(uint32_t n);
/* P9.25 is on the pipeline's class, with no request since. */
bool p925_following(void);
void p925_status(char *buf, size_t len);
void p925_request(const char *who, const struct ai64_ipc_msg *req, struct ai64_ipc_msg *rep);
uint32_t p925_fab_action(uint32_t action, uint32_t arg0, uint32_t arg1);
/* Its struct ai64_pwm_status, in this node's fabric page. */
void p925_publish(volatile void *page, uint32_t now);
/* Starts the steps. */
void p925_start(void);

/* The pipeline's last stage, pipe_pwm.c: starts its thread. */
void pipe_pwm_start(void);

#endif
```
