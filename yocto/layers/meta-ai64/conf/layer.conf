## yocto/layers/meta-ai64/conf/layer.conf
```bitbake
BBPATH .= ":${LAYERDIR}"

BBFILES += "${LAYERDIR}/recipes-*/*/*.bb ${LAYERDIR}/recipes-*/*/*.bbappend"

BBFILE_COLLECTIONS += "meta-ai64"
BBFILE_PATTERN_meta-ai64 = "^${LAYERDIR}/"
BBFILE_PRIORITY_meta-ai64 = "10"

LAYERDEPENDS_meta-ai64 = "core"
LAYERSERIES_COMPAT_meta-ai64 = "wrynose"
LAYERVERSION_meta-ai64 = "1"
```

## zephyr/r5/common/dts/bindings/ai64,secure-proxy-poll.yaml
```yaml
# SPDX-License-Identifier: MIT
description: |
  The main secure proxy, as a mailbox with no interrupt: a send waits for
  the answer on the enabled receive threads (zephyr/r5/common/src/sproxy.c).
  It carries Zephyr's TI-SCI driver (ti,k2g-sci) on the main-domain R5Fs,
  where no secure proxy interrupt is routed. A channel is a secure proxy
  thread.

compatible: "ai64,secure-proxy-poll"

include: [base.yaml, mailbox-controller.yaml]

properties:
  reg:
    required: true

  reg-names:
    required: true
    description: '"target_data" and "rt"'

mbox-cells:
  - channel
```
